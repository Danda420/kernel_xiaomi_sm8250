## drivers/oplus/Kconfig
```kconfig
# SPDX-License-Identifier: GPL-2.0-only
# Copyright (C) 2018-2020 Oplus. All rights reserved.

config OPLUS_OPROJECT
	bool "oplus project"
	depends on OPLUS
	default y
	help
	 define this config to define oplus project
	  
config OPLUS_NANDSWAP
	bool "nandswap feature"
	depends on OPLUS
	default y
	help
	 nandswap feature

config OPLUS_NANDSWAP_DEBUG
	bool "nandswap debug"
	depends on F2FS_FS
	default n
	help
	 nandswap debug

config OPLUS_SUBSYS_SLEEP_MONITOR
	bool "monitor Qualcomm subsystem sleep"
	depends on OPLUS
	default y
	help
	  This selects to get sleep info for Qualcomm subsystem

config OPLUS_WAKELOCK_PROFILER
	bool "config oplus wakelock profiler"
	depends on OPLUS
	default y
	help
		Select this config to enable oplus wakelock profiler

config OPLUS_POWERINFO_STANDBY_DEBUG
	bool "powerinfo standby config"
	default n
	help
		Select this config to enable powerinfo standby debug

config OPLUS_POWERINFO_RPMH
	bool "powerinfo rpmh config"
	default n
	help
		Select this config to enable powerinfo rpmh

config OPLUS_POWERINFO_FTM
	bool "powerinfo ftm config"
	default n
	help
		Select this config to enable powerinfo ftm
	
```

## drivers/oplus/oplus_performance/healthinfo/fs/Kconfig
```kconfig
config FG_TASK_UID
	bool "Enable /proc/fg_info/ if EXPERT"
	default y
	help
	  Add foreground process optimize support to promote performance .

config OPLUS_JANK_INFO
	bool "Enable /proc/pid/jank_info if EXPERT"
	default n
	help
	  Add jank monitor opt support .
```

## net/oplus_nwpower/Kconfig
```kconfig
# SPDX-License-Identifier: GPL-2.0-only
# Copyright (C) 2020-2022 Oplus. All rights reserved.

config OPLUS_NWPOWER
    bool "OPLUS NWPOWER"
    default y
    depends on OPLUS
    help
	 add for oplus wakelock_profiler
```

## techpack/Kconfig
```kconfig
menu "Tech packages"

source "techpack/data/Kconfig"
source "techpack/wlan/Kconfig"

endmenu
```

## techpack/display/Kconfig
```kconfig
menu "MSM DRM driver"

config DRM_DYNAMIC_REFRESH_RATE
	bool
	default y if ARCH_KONA || ARCH_LITO

endmenu
```
